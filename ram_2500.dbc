VERSION ""

NS_ :

BS_:

BU_: XXX

BO_ 55 NEW_MSG_1: 8 XXX
 SG_ NEW_SIGNAL_1 : 23|23@0+ (1,0) [0|8388607] "" XXX
